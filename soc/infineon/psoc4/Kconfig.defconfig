## soc/infineon/psoc4/Kconfig.defconfig
```kconfig
# Copyright (c) 2025 Infineon Technologies AG,
# or an affiliate of Infineon Technologies AG.
#
# SPDX-License-Identifier: Apache-2.0

if SOC_FAMILY_INFINEON_PSOC4

rsource "*/Kconfig.defconfig"

configdefault SHARED_IRQ_MAX_NUM_CLIENTS
	# All 3 GPIO ports enabled
	default 3 if $(dt_nodelabel_enabled,gpio_prt4) && \
		$(dt_nodelabel_enabled,gpio_prt5) && \
		$(dt_nodelabel_enabled,gpio_prt6)

	# Any 2 GPIO ports enabled
	default 2 if $(dt_nodelabel_enabled,gpio_prt4) && $(dt_nodelabel_enabled,gpio_prt5)
	default 2 if $(dt_nodelabel_enabled,gpio_prt4) && $(dt_nodelabel_enabled,gpio_prt6)
	default 2 if $(dt_nodelabel_enabled,gpio_prt5) && $(dt_nodelabel_enabled,gpio_prt6)

configdefault SHARED_INTERRUPTS
default y if (($(dt_nodelabel_enabled,gpio_prt4) && \
		($(dt_nodelabel_enabled,gpio_prt5) || $(dt_nodelabel_enabled,gpio_prt6))) || \
		($(dt_nodelabel_enabled,gpio_prt5) && $(dt_nodelabel_enabled,gpio_prt6)))

endif # SOC_FAMILY_INFINEON_PSOC4
```
